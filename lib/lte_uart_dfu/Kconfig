## lib/lte_uart_dfu/Kconfig
```kconfig
#
# Copyright (c) 2018 Nordic Semiconductor
#
# SPDX-License-Identifier: LicenseRef-BSD-5-Clause-Nordic
#

menu "LTE UART DFU library"

config LTE_UART_DFU
	bool "LTE UART DFU library"
	depends on DFU_TARGET
	depends on DFU_TARGET_MCUBOOT
	depends on SERIAL
	depends on UART_INTERRUPT_DRIVEN

if LTE_UART_DFU

config LTE_UART_DFU_DEV_NAME
	string "UART interface name"
	default ""

config LTE_UART_DFU_HANDLER_STACK_SIZE
	int "Thread stack size"
	default 512

config LTE_UART_DFU_HANDLER_PRIORITY
	int "Thread priority"
	default 4

config LTE_UART_DFU_IN_BUFFER_SIZE
	int "Input buffer size"
	default 4096

config LTE_UART_DFU_OUT_BUFFER_SIZE
	int "Output buffer size"
	default 128

module=LTE_UART_DFU
module-dep=LOG
module-str=Device Firmware Upgrade using UART
source "${ZEPHYR_BASE}/subsys/logging/Kconfig.template.log_config"

endif # LTE_UART_DFU

endmenu
```

## subsys/event_manager/Kconfig
```kconfig
#
# Copyright (c) 2018 Nordic Semiconductor
#
# SPDX-License-Identifier: LicenseRef-Nordic-5-Clause
#

menuconfig EVENT_MANAGER
	bool
	prompt "Event Manager"
	depends on LINKER_ORPHAN_SECTION_PLACE
	help
	  Enable Event Manager.
	  Note that Event Manager uses orphan sections to handle its
	  data structures.

if EVENT_MANAGER

config EVENT_MANAGER_SHOW_EVENTS
	bool "Show events"
	depends on LOG
	default y
	help
	  This option controls if events are printed to console.

config EVENT_MANAGER_SHOW_EVENT_HANDLERS
	bool "Show event handlers"
	depends on EVENT_MANAGER_SHOW_EVENTS
	help
	  This option controls if event handlers are printed to console.

module = EVENT_MANAGER
module-str = Event Manager
source "${ZEPHYR_BASE}/subsys/logging/Kconfig.template.log_config"

config EVENT_MANAGER_EVENT_LOG_BUF_LEN
	int "Length of buffer for processing event message"
	default 128
	range 2 1024

config EVENT_MANAGER_LOG_EVENT_TYPE
	bool "Include event type in the event log output"
	default y

config EVENT_MANAGER_MAX_EVENT_CNT
	int "Maximum number of event types"
	default 32
	help
	  Maximum number of declared event types in Event Manager.

config EVENT_MANAGER_STORAGE
	bool "Store event in non-volatile memory"
	default n

if EVENT_MANAGER_STORAGE

partition=EVENTS_STORAGE
partition-size=0x10000
source "${ZEPHYR_BASE}/../nrf/subsys/partition_manager/Kconfig.template.partition_size"

config EVENT_STORAGE_EXT_FLASH
	bool "Event storage partition on external flash"

choice EVENT_MANAGER_STORAGE_BACKEND
	bool "Event storage backend"
	default EVENT_MANAGER_STORAGE_BACKEND_LITTLEFS if FILE_SYSTEM_LITTLEFS
	default EVENT_MANAGER_STORAGE_BACKEND_NVS if NVS

config EVENT_MANAGER_STORAGE_BACKEND_LITTLEFS
	bool "Littlefs backend"
	depends on FILE_SYSTEM_LITTLEFS

config EVENT_MANAGER_STORAGE_BACKEND_NVS
	bool "NVS backend"
	depends on NVS

endchoice # EVENT_MANAGER_STORAGE_BACKEND

endif # EVENT_MANAGER_STORAGE

config EVENT_MANAGER_STORAGE_PAYLOAD_MAX_SIZE
	int "Maximum size of event payload"
	default 64

config EVENT_MANAGER_WORKQ_STACK_SIZE
	int "Event manager work queue tack size"
	default 2048

endif # EVENT_MANAGER
```
